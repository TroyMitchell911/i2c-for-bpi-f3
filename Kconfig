## Kconfig
```kconfig
config I2C_K1
	tristate "Spacemit K1 I2C adapter"
	depends on ARCH_SPACEMIT || COMPILE_TEST
	depends on OF
	help
	  This option enables support for the I2C interface on the Spacemit K1
	  platform.

	  If you enable this configuration, the kernel will include support for
	  the I2C adapter specific to the Spacemit K1 platform. This driver can
	  be used to manage I2C bus transactions, which are necessary for
	  interfacing with I2C peripherals such as sensors, EEPROMs, and other
	  devices.

    This driver can also be built as a module.  If so, the
    module will be called `i2c-k1`.
```
